/ {
    chosen {
        zmk,kscan = &mock_kscan;
    };

    mock_kscan: kscan {
        compatible = "zmk,kscan-mock";
        label = "KSCAN";
        rows = <6>;
        columns = <16>;
        // Формат: <ряд колонка нажатие(1/0) отпускание(1/0) задержка_в_мкс>
        // Нулевые значения делают событие безвредным.
        events = <0 0 0 0 0>;
        status = "okay";
    };
};
