## boards/shields/KeyboardViridi/Kconfig.defconfig
```kconfig
if SHIELD_KeyboardViridi

    config ZMK_KEYBOARD_NAME
        default "ViridiKeyboard"

    config ZMK_USB
        default y

    config ZMK_STUDIO
        default y

endif
```

## boards/shields/KeyboardViridi/Kconfig.shield
```kconfig
config SHIELD_KeyboardViridi
    def_bool $(shields_list_contains,KeyboardViridi)
    select SPI
```
